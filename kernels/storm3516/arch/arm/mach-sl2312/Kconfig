## kernels/storm3516/arch/arm/mach-sl2312/Kconfig
```kconfig
menu "SL2312"

config SL3516_ASIC
	bool "SL3516 ASIC version"
	depends on ARCH_SL2312
	help
	  This option to select AISC or FPGA
config PCI
       bool "SL2312 PCI"
       depends on ARCH_SL2312
       help
         This option to enable Storlink PCI controller

config DUAL_PCI
	bool "Split PCI slot"
	depends on GEMINI_IPI && PCI
	help 
	  This option enable dual core to handle pci device simultaneously(different slot)

config SL2312_LPC
       bool "SL2312 LPC"
       depends on ARCH_SL2312
       help
         This option to enable Low Pin Count controller

config SL2312_USB
       bool "SL2312 USB"
       depends on ARCH_SL2312
       help
         This option to enable USB OTG host contrller

config GEMINI_IPI
       bool "Gemini IPI test"
       depends on ARCH_SL2312
       help
	 this option Enable dual core function for gemini proj 
endmenu
```

## kernels/storm3516/drivers/crypto/Kconfig
```kconfig
menu "Hardware crypto devices"

config CRYPTO_DEV_PADLOCK
	tristate "Support for VIA PadLock ACE"
	depends on CRYPTO && X86_32
	help
	  Some VIA processors come with an integrated crypto engine
	  (so called VIA PadLock ACE, Advanced Cryptography Engine)
	  that provides instructions for very fast {en,de}cryption 
	  with some algorithms.
	  
	  The instructions are used only when the CPU supports them.
	  Otherwise software encryption is used. If you are unsure,
	  say Y.

config CRYPTO_DEV_PADLOCK_AES
	bool "Support for AES in VIA PadLock"
	depends on CRYPTO_DEV_PADLOCK
	default y
	help
	  Use VIA PadLock for AES algorithm.

config SL2312_IPSEC
	tristate "Storlink H/W IPSec Acceleration Engine"
	depends on CRYPTO
	help
	    Storlink H/W crypto engine include MD5,SHA1,HMAC-MD5,HMAC-SHA1,
	    DES,3DES and AES.

endmenu
```

## kernels/storm3516/drivers/net/sk98lin/Kconfig
```kconfig
config SK98LIN
	tristate "Marvell Yukon Chipset / SysKonnect SK-98xx Support"
	depends on PCI
	---help---
	  Say Y here if you have a Marvell Yukon or SysKonnect SK-98xx/SK-95xx
	  compliant Gigabit Ethernet Adapter. The following adapters are supported
	  by this driver:
	    - 3Com 3C940 Gigabit LOM Ethernet Adapter
	    - 3Com 3C941 Gigabit LOM Ethernet Adapter
	    - 88E8021 Marvell 1000 Mbit PCI-X, single Port Copper 
	    - 88E8021 Marvell 1000 Mbit PCI-X, single Port Fiber LX 
	    - 88E8021 Marvell 1000 Mbit PCI-X, single Port Fiber SX 
	    - 88E8022 Marvell 1000 Mbit PCI-X, dual Port Copper 
	    - 88E8022 Marvell 1000 Mbit PCI-X, dual Port Copper (Gateway) 
	    - 88E8022 Marvell 1000 Mbit PCI-X, dual Port Fiber LX 
	    - 88E8022 Marvell 1000 Mbit PCI-X, dual Port Fiber SX 
	    - 88E8061 Marvell 1000 Mbit PCI-E, single Port Copper 
	    - 88E8061 Marvell 1000 Mbit PCI-E, single Port Fiber LX 
	    - 88E8061 Marvell 1000 Mbit PCI-E, single Port Fiber SX 
	    - 88E8062 Marvell 1000 Mbit PCI-E, dual Port Copper 
	    - 88E8062 Marvell 1000 Mbit PCI-E, dual Port Copper (Gateway) 
	    - 88E8062 Marvell 1000 Mbit PCI-E, dual Port Fiber LX 
	    - 88E8062 Marvell 1000 Mbit PCI-E, dual Port Fiber SX 
	    - Abocom EFE3K - 10/100 Ethernet Expresscard
	    - Abocom EGE5K - Giga Ethernet Expresscard
	    - Allied Telesyn AT-2970LX Gigabit Ethernet Adapter
	    - Allied Telesyn AT-2970LX/2SC Gigabit Ethernet Adapter
	    - Allied Telesyn AT-2970SX Gigabit Ethernet Adapter
	    - Allied Telesyn AT-2970SX/2SC Gigabit Ethernet Adapter
	    - Allied Telesyn AT-2970TX Gigabit Ethernet Adapter
	    - Allied Telesyn AT-2970TX/2TX Gigabit Ethernet Adapter
	    - Allied Telesyn AT-2971SX Gigabit Ethernet Adapter
	    - Allied Telesyn AT-2971T Gigabit Ethernet Adapter
	    - Belkin Gigabit Desktop Card 10/100/1000Base-T Adapter, Copper RJ-45
	    - DGE-530T Gigabit Ethernet Adapter
	    - DGE-560T Gigabit Ethernet Adapter
	    - EG1032 v2 Instant Gigabit Network Adapter
	    - EG1064 v2 Instant Gigabit Network Adapter
	    - Marvell 88E8001 Gigabit Ethernet Controller (Abit)
	    - Marvell 88E8001 Gigabit Ethernet Controller (Albatron)
	    - Marvell 88E8001 Gigabit Ethernet Controller (Asus)
	    - Marvell 88E8001 Gigabit Ethernet Controller (Chaintech)
	    - Marvell 88E8001 Gigabit Ethernet Controller (ECS)
	    - Marvell 88E8001 Gigabit Ethernet Controller (Epox)
	    - Marvell 88E8001 Gigabit Ethernet Controller (Foxconn)
	    - Marvell 88E8001 Gigabit Ethernet Controller (Gigabyte)
	    - Marvell 88E8001 Gigabit Ethernet Controller (Iwill)
	    - Marvell 88E8035 Fast Ethernet Controller (LGE)
	    - Marvell 88E8035 Fast Ethernet Controller (Toshiba)
	    - Marvell 88E8036 Fast Ethernet Controller (Arima)
	    - Marvell 88E8036 Fast Ethernet Controller (Compal)
	    - Marvell 88E8036 Fast Ethernet Controller (Inventec)
	    - Marvell 88E8036 Fast Ethernet Controller (LGE)
	    - Marvell 88E8036 Fast Ethernet Controller (Mitac)
	    - Marvell 88E8036 Fast Ethernet Controller (Panasonic)
	    - Marvell 88E8036 Fast Ethernet Controller (Quanta)
	    - Marvell 88E8036 Fast Ethernet Controller (Toshiba)
	    - Marvell 88E8036 Fast Ethernet Controller (Wistron)
	    - Marvell 88E8050 Gigabit Ethernet Controller (Gateway)
	    - Marvell 88E8050 Gigabit Ethernet Controller (Intel)
	    - Marvell 88E8052 Gigabit Ethernet Controller (ASRock)
	    - Marvell 88E8052 Gigabit Ethernet Controller (Aopen)
	    - Marvell 88E8052 Gigabit Ethernet Controller (Asus)
	    - Marvell 88E8052 Gigabit Ethernet Controller (Gateway)
	    - Marvell 88E8052 Gigabit Ethernet Controller (Gigabyte)
	    - Marvell 88E8052 Gigabit Ethernet Controller (MSI)
	    - Marvell 88E8052 Gigabit Ethernet Controller (Wistron)
	    - Marvell 88E8053 Gigabit Ethernet Controller (ASRock)
	    - Marvell 88E8053 Gigabit Ethernet Controller (Albatron)
	    - Marvell 88E8053 Gigabit Ethernet Controller (Aopen)
	    - Marvell 88E8053 Gigabit Ethernet Controller (Arima)
	    - Marvell 88E8053 Gigabit Ethernet Controller (Asus)
	    - Marvell 88E8053 Gigabit Ethernet Controller (Chaintech)
	    - Marvell 88E8053 Gigabit Ethernet Controller (Clevo)
	    - Marvell 88E8053 Gigabit Ethernet Controller (Compal)
	    - Marvell 88E8053 Gigabit Ethernet Controller (DFI)
	    - Marvell 88E8053 Gigabit Ethernet Controller (ECS)
	    - Marvell 88E8053 Gigabit Ethernet Controller (Epox)
	    - Marvell 88E8053 Gigabit Ethernet Controller (Gigabyte)
	    - Marvell 88E8053 Gigabit Ethernet Controller (Inventec)
	    - Marvell 88E8053 Gigabit Ethernet Controller (LGE)
	    - Marvell 88E8053 Gigabit Ethernet Controller (MSI)
	    - Marvell 88E8053 Gigabit Ethernet Controller (Mitac)
	    - Marvell 88E8053 Gigabit Ethernet Controller (Panasonic)
	    - Marvell 88E8053 Gigabit Ethernet Controller (Quanta)
	    - Marvell 88E8053 Gigabit Ethernet Controller (SOYO)
	    - Marvell 88E8053 Gigabit Ethernet Controller (Shuttle)
	    - Marvell 88E8053 Gigabit Ethernet Controller (Toshiba)
	    - Marvell 88E8053 Gigabit Ethernet Controller (Trigem)
	    - Marvell RDK-8001 
	    - Marvell RDK-8001 Adapter
	    - Marvell RDK-8002 Adapter
	    - Marvell RDK-8003 
	    - Marvell RDK-8003 Adapter
	    - Marvell RDK-8004 Adapter
	    - Marvell RDK-8006 Adapter
	    - Marvell RDK-8007 Adapter
	    - Marvell RDK-8008 Adapter
	    - Marvell RDK-8009 Adapter
	    - Marvell RDK-8010 
	    - Marvell RDK-8011 Adapter
	    - Marvell RDK-8012 Adapter
	    - Marvell RDK-8035 
	    - Marvell RDK-8036 
	    - Marvell RDK-8052 
	    - Marvell RDK-8053 
	    - Marvell Yukon Gigabit Ethernet 10/100/1000Base-T Controller (32 bit)
	    - Marvell Yukon Gigabit Ethernet 10/100/1000Base-T Controller (64 bit)
	    - Marvell Yukon-EC Ultra, no ASF (Battery Power Service Support)
	    - Marvell Yukon-FE Fast Ethernet, Reduced Battery Power Service Support)
	    - N-Way PCI-Bus Giga-Card 1000/100/10Mbps(L)
	    - SK-9521 10/100/1000Base-T Adapter
	    - SK-9521 V2.0 10/100/1000Base-T Adapter
	    - SK-9821 Gigabit Ethernet Server Adapter (SK-NET GE-T)
	    - SK-9821 V2.0 Gigabit Ethernet 10/100/1000Base-T Adapter
	    - SK-9822 Gigabit Ethernet Server Adapter (SK-NET GE-T dual link)
	    - SK-9841 Gigabit Ethernet Server Adapter (SK-NET GE-LX)
	    - SK-9841 V2.0 Gigabit Ethernet 1000Base-LX Adapter
	    - SK-9842 Gigabit Ethernet Server Adapter (SK-NET GE-LX dual link)
	    - SK-9843 Gigabit Ethernet Server Adapter (SK-NET GE-SX)
	    - SK-9843 V2.0 Gigabit Ethernet 1000Base-SX Adapter
	    - SK-9844 Gigabit Ethernet Server Adapter (SK-NET GE-SX dual link)
	    - SK-9851 V2.0 Gigabit Ethernet 1000Base-SX Adapter
	    - SK-9861 Gigabit Ethernet Server Adapter (SK-NET GE-SX Volition)
	    - SK-9861 V2.0 Gigabit Ethernet 1000Base-SX Adapter
	    - SK-9862 Gigabit Ethernet Server Adapter (SK-NET GE-SX Volition dual link)
	    - SK-9871 Gigabit Ethernet Server Adapter (SK-NET GE-ZX)
	    - SK-9871 V2.0 Gigabit Ethernet 1000Base-ZX Adapter
	    - SK-9872 Gigabit Ethernet Server Adapter (SK-NET GE-ZX dual link)
	    - SK-9S21 Server Adapter 
	    - SK-9S22 Server Adapter 
	    - SK-9S24 Server Adapter 
	    - SK-9S34 Server Adapter 
	    - SK-9S81 Server Adapter 
	    - SK-9S82 Server Adapter 
	    - SK-9S91 Server Adapter 
	    - SK-9S92 Server Adapter 
	    - SMC EZ Card 1000 (SMC9452TXV.2)
	  
	  The adapters support Jumbo Frames.
	  The dual link adapters support link-failover and dual port features.
	  Both Marvell Yukon and SysKonnect SK-98xx/SK-95xx adapters support 
	  the scatter-gather functionality with sendfile(). Please refer to 
	  Documentation/networking/sk98lin.txt for more information about
	  optional driver parameters.
	  Questions concerning this driver may be addressed to:
	      linux@syskonnect.de
	  
	  If you want to compile this driver as a module ( = code which can be
	  inserted in and removed from the running kernel whenever you want),
	  say M here and read Documentation/modules.txt. This is recommended.
	  The module will be called sk98lin. This is recommended.

config SK98LIN_NAPI
	bool "Use Rx polling (NAPI)"
	depends on SK98LIN
	help
	  NAPI is a new driver API designed to reduce CPU and interrupt load
	  when the driver is receiving lots of packets from the card.
```

## kernels/storm3516/drivers/usb/OTG/Kconfig
```kconfig
#
# USB OTG Controller Drivers
#
comment "USB OTG Controller Drivers"
	depends on SL2312_USB
config USB_OTG_SL2312
	tristate "SL2312 OTG support"
	depends on SL2312_USB
	default N
	help
	  The SL2312 is a single-port USB controller that supports either
	  host side or peripheral side roles.  Enable this option if your
	  board has this chip, and you want to use it as a host controller. 
	  If unsure, say N.

	  To compile this driver as a module, choose M here: the
	  module will be called FTC_FOTG2XX.o .
	  
config USB_OTG_SL2312_1
	tristate "SL2312 port 1 OTG support"
	depends on SL2312_USB
	default N
	help
	  The SL2312 is a single-port USB controller that supports either
	  host side or peripheral side roles.  Enable this option if your
	  board has this chip, and you want to use it as a host controller. 
	  If unsure, say N.

	  To compile this driver as a module, choose M here: the
	  module will be called FTC_FOTG2XX_1.o .
```
